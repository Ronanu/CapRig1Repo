## esp32_microros_udp_min/main/Kconfig.projbuild
```kconfig
menu "App configuration"

config WIFI_SSID
    string "Wi-Fi SSID"
    default "HochbuerglInet"
    help
        SSID of the Wi-Fi network to connect to.

config WIFI_PASSWORD
    string "Wi-Fi password"
    default "08150815"
    help
        Password of the Wi-Fi network.

config PUB_PERIOD_MS
    int "Heartbeat publish period (ms)"
    default 500
    range 50 60000
    help
        Period in milliseconds for the Int32 heartbeat publisher.

endmenu
```

## esp32_microros_udp_min/sdkconfig.defaults
```kconfig
CONFIG_ESP_PM_ENABLE=n

CONFIG_MICRO_ROS_TRANSPORT_UDP=y
CONFIG_MICRO_ROS_AGENT_IP="192.168.1.2"
CONFIG_MICRO_ROS_AGENT_PORT="8888"
CONFIG_MICRO_ROS_XRCE_DDS_MIDDLEWARE=y

CONFIG_ESP_WIFI_DYNAMIC_RX_BUFFER_NUM=32
CONFIG_ESP_WIFI_DYNAMIC_TX_BUFFER_NUM=32

CONFIG_LWIP_TCPIP_TASK_STACK_SIZE=4096
CONFIG_LWIP_UDP_RECVMBOX_SIZE=20
CONFIG_LWIP_TCPIP_RECVMBOX_SIZE=64
```
